#define MISO    12
#define MOSI    11
#define CLK     13
#define RST     10

uint8_t program[] = {0x2, 0x0, 0x6, 0x2, 0x0, 0x62, 0x75, 0x81, 0x7, 0x12, 0x0, 0x98, 0xe5,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 0x0, 0x22};


void setup()
{
    Serial.begin(9600);
    
    pinMode(MISO, INPUT);
    pinMode(MOSI, OUTPUT);
    pinMode(CLK, OUTPUT);
    pinMode(RST, OUTPUT);

    //Apaga
    digitalWrite(RST, 1);
    programming_enable();
    erase_memory();

    //Escreve
    programming_enable();
    uint8_t addr = 0;
    for(uint8_t i = 0; i < 156; i++)
    {
        transfer_spi(0x40);
        transfer_spi(0x00);
        transfer_spi(addr++);
        transfer_spi(program[i]);
    }
    delay(500);
    digitalWrite(RST, 0);

    /*
    //Lê
    programming_enable();
    addr = 0;
    for(uint8_t i = 0; i < 41; i++)
    {
        transfer_spi(0x20);
        transfer_spi(0x00);
        transfer_spi(addr++);
        uint8_t blido = transfer_spi(0x00);
        Serial.println(blido, HEX);
    }
    */
}

void loop()
{
    
}

uint8_t transfer_spi(uint8_t data)
{
    /*
    A função atua tanto para leitura, quanto para escrita na memória do uc
    O modo de operação da função de transferência é definido pelos bytes de instrução enviados

    Quando definido o modo de escrita:
    O byte "data" é escrito bit a bit no uc
    - Byte 1 : Write Program Memory (byte mode)
    - Byte 2 : Addr High Byte
    - Byte 3 : ADDR Low Byte
    - Byte 4 : Data byte

    Quando definido o modo de leitura:
    O byte é lido bit bit na variavel "read_ bit", e então é formado um byte na variavel "read_byte"
    - Byte 1 : Read Program Memory (byte mode)
    - Byte 2 : Addr High Byte
    - Byte 3 : ADDR Low Byte
    - Byte 4 : Dummy Data

    */
    uint8_t read_byte = 0;     //Byte que será construído com os bits lidos
    uint8_t read_bit;          //Bit lido

    for(uint8_t i = 0; i < 8; i++)
    {
        if(data & 0x80) digitalWrite(MOSI, 1);
        else digitalWrite(MOSI, 0);

        digitalWrite(CLK, 1);
        delayMicroseconds(2);

        read_bit = digitalRead(MISO);
        
        digitalWrite(CLK, 0);
        delayMicroseconds(2);

        if(read_bit) read_byte |= 1;
        else read_byte &= 0xFE;

        if(i != 7)
        {
            read_byte <<= 1;
            data <<= 1;
        }
    }
    return read_byte;
}

void programming_enable()
{    
    transfer_spi(0xAC);
    transfer_spi(0x53);
    transfer_spi(0x00);
    transfer_spi(0x00);
    delay(500);
}

void erase_memory()
{
    transfer_spi(0xAC);
    transfer_spi(0x80);
    transfer_spi(0x00);
    transfer_spi(0x00);
    delay(500);
}